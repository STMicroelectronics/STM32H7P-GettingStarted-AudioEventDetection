# STM32H7P5 register map
File version: 0.1
CPU: CM7 r1p2, little endian, MPU, FPU, 4 interrupt priority bits
Registers are 32-bit, read-write, reset 0x0 unless marked. A register's access mark holds for its fields unless they carry their own. Offsets are from the block's base; lines under a group give offsets from that group; [hi:lo] are bit positions; {n}, {i} and the like mark numbered series; 'fields as' and 'values as' point back to an identical list; <NAME> marks a mode.

## Memory map
0x40000000 TIM2 size 0x3E4 — TIM2 address block description
0x40000C00 TIM5 size 0x3E4
0x40001000 TIM6 size 0x30 — TIM address block description
0x40001400 TIM7 size 0x30
0x40001800 TIM12 size 0x60
0x40001C00 TIM13 size 0x60
0x40002000 TIM14 size 0x60
0x40002400 LPTIM1 size 0x400 — LPTIM1 register block
0x40002C00 WWDG size 0x400 — WWDG register block
0x40003000 TIM10 size 0x60 — General purpose timer
0x40003400 TIM11 size 0x60
0x40003800 SPI2 size 0x400
0x40003C00 SPI3 size 0x400
0x40004400 USART2 size 0x400
0x40004800 USART3 size 0x400
0x40004C00 UART4 size 0x400
0x40005000 UART5 size 0x400
0x40005400 I2C1 size 0x2C — I2C address block description
0x40005800 I2C2 size 0x2C
0x40005C00 I2C3 size 0x2C
0x40006000 I3C1 size 0x400 — I3C register block
0x40007800 UART7 size 0x400
0x40007C00 UART8 size 0x400
0x40008400 CRS size 0x400 — CRS register block
0x4000A000 FDCAN1 size 0x400 — FDCAN register blank and RAM
0x4000A400 FDCAN2 size 0x400
0x4000A800 FDCAN3 size 0x400
0x4000EC00 UCPD size 0x400 — UCPD register block
0x40020C00 HSP size 0x400 — HSP register block
0x40021000 GPDMA1 size 0x1000 — GPDMA register block
0x4002F000 ADF1 size 0x1000 — ADF register block
0x40080000 OTG_FS size 0xE08 — OTG address block description
0x42000000 TIM1 size 0x3E4 — General purpose timer
0x42000400 TIM8 size 0x3E4
0x42000800 TIM20 size 0x3E4
0x42001000 USART1 size 0x400 — USART register block
0x42001400 USART6 size 0x400
0x42001800 UART9 size 0x400
0x42001C00 USART10 size 0x400
0x42003000 SPI1 size 0x400 — Serial peripheral interface
0x42003400 SPI4 size 0x400
0x42004C00 TIM9 size 0x60 — General purpose timer
0x42005000 SPI5 size 0x400
0x42006000 HRTIM1 size 0x7C4 — HRTIM address block description
0x42007000 HRTIM2 size 0x7C4
0x46001400 SPI6 size 0x400
0x48004400 CORDIC size 0x400 — CORDIC register block
0x48004800 FMAC size 0x400 — FMAC register block
0x48020400 HASH size 0x400 — HASH register bank
0x48026000 ADC1 size 0x100 — Analog-to-digital converters
0x48026100 ADC2 size 0x100
0x48026300 ADCC12 size 0x14 — Analog-to-digital converters
0x48026400 ADC3 size 0x100
0x48026500 ADC4 size 0x100
0x48026700 ADCC34 size 0x14
0x48027000 DAC size 0x3F0 — DAC address block description
0x48027400 DAC34 size 0x3F0
0x48027800 DAC56 size 0x3F0
0x48027C00 DAC78 size 0x3F0
0x52000000 HPDMA1 size 0x1000 — HPDMA register block
0x52002000 FLASH size 0x500 — FLASH register bank
0x52004000 FMC size 0x15C — FMC address block description
0x52005000 XSPI size 0x400 — XSPI register block
0x52006000 DLYBXS1 size 0x400 — DLYB register block
0x52007000 SDMMC size 0x400 — SDMMC register block
0x52008000 DLYBSD1 size 0x400
0x52009000 RAMECC1 size 0xF8 — RAMECC address block description
0x58000000 EXTI size 0x400 — EXTI register block
0x58000400 SBS size 0x400 — SBS register block
0x58000C00 LPUART1 size 0x30 — LPUART address block description
0x58002400 LPTIM2 size 0x400
0x58002800 LPTIM3 size 0x400
0x58002C00 LPTIM4 size 0x400
0x58003000 LPTIM5 size 0x400
0x58003C00 VREFBUF size 0x8 — VREFBUF register block
0x58004000 RTC size 0x400 — RTC register block
0x58004400 TAMP size 0x400 — TAMP register block
0x58004800 IWDG size 0x400 — IWDG register block
0x58006800 DTS size 0x400 — DTS register block
0x58007000 COMP size 0x200 — COMP register block
0x58007400 COMP34 size 0x200
0x58007800 COMP56 size 0x200
0x58007C00 COMP78 size 0x200
0x58020000 GPIOA size 0x2C — GPIO address block description
0x58020400 GPIOB size 0x2C — GPIO address block description
0x58020800 GPIOC size 0x2C — GPIO address block description
0x58020C00 GPIOD size 0x2C — GPIO address block description
0x58021000 GPIOE size 0x2C — GPIO address block description
0x58021400 GPIOF size 0x2C — GPIO address block description
0x58021800 GPIOG size 0x2C — GPIO address block description
0x58021C00 GPIOH size 0x2C — GPIO address block description
0x58022000 GPIOI size 0x2C — GPIO address block description
0x58024400 RCC size 0x204 — RCC register block
0x58024800 PWR size 0x400 — PWR register block
0x58024C00 CRC size 0x18 — CRC register block
0x58027000 RAMECC2 size 0xF8
0x5C001000 DBGMCU size 0x1000 — DBGMCU address block description

## Interrupts
2 DTS — DTS global interrupt
3 IWDG_EWIT (IWDG) — Independent watchdog early warning interrupt
4 WWDG_EWIT (WWDG) — Window Watchdog early warning interrupt
5 RCC — RCC_RDY interrupt (Osc, PLL)
8 FLASH — Flash interface
9 RAMECC1 — RAMECC1 OR RAMECC2 interrupt
13 TAMP — Tamper interrupt through the EXTI line
{n+16} EXTI{n} (EXTI) (n=0..15) — EXTI Line {n} interrupt through the EXTI line
32 RTC — RTC Wakeup/alarmA+B/timestamp/SSRU interrupt through the EXTI line
34 ADC2 — ADC2 global interrupt
35 ADC4 — ADC4 global interrupt
36 HASH — HASH global interrupt
38 ADC1 — ADC1 global interrupt
{n+39} GPDMA1_CH{n} (GPDMA1) (n=0..7) — GPDMA1 channel {n} interrupt
47 TIM1_BRK_TERR_IERR (TIM1) — TIM1 Break interrupt
48 TIM1_UPD (TIM1) — TIM1 Update interrupt
49 TIM1_TRGI_COM_DIR_IDX (TIM1) — TIM1 Trigger and Commutation interrupts
50 TIM1_CC (TIM1) — TIM1 Capture Compare interrupt
51 TIM2 — TIM2 global interrupt
54 TIM5 — TIM5 global interrupt
55 TIM6 — TIM6 global interrupt
56 TIM7 — TIM7 global interrupt
57 TIM9 — TIM9 global interrupt
58 SPI1 — SPI1 global interrupt
59 SPI2 — SPI2 global interrupt
60 SPI3 — SPI3 global interrupt
61 SPI4 — SPI4 global interrupt
62 SPI5 — SPI5 global interrupt
63 SPI6 — SPI6 global interrupt
{n+64} HPDMA1_CH{n} (HPDMA1) (n=0..7) — HPDMA1 channel {n} interrupt
72 TIM8_BRK_TERR_IERR (TIM8) — TIM8 Break interrupt/TIM8 Transition error/TIM8 Index error
73 TIM8_UPD (TIM8) — TIM8 Update interrupt
74 TIM8_TRGI_COM_DIR_IDX (TIM8) — TIM8 trigger and commutation interrupt/TIM8 Direction Change interrupt/TIM8 Index
75 TIM8_CC (TIM8) — TIM8 capture compare interrupt
76 I2C1_EV (I2C1) — I2C1 event interrupt
77 I2C1_ERR (I2C1) — I2C1 error interrupt
78 I2C2_EV (I2C2) — I2C2 event interrupt
79 I2C2_ERR (I2C2) — I2C2 error interrupt
80 I2C3_EV (I2C3) — I2C3 event interrupt
81 I2C3_ERR (I2C3) — I2C3 error interrupt
82 USART1 — USART1 global interrupt
83 USART2 — USART2 global interrupt
84 USART3 — USART3 global interrupt
85 UART4 — UART4 global interrupt
86 UART5 — UART5 global interrupt
87 UART7 — UART7 global interrupt
88 UART8 — UART8 global interrupt
89 I3C1_EV (I3C1) — I3C1 event interrupt
90 I3C1_ERR (I3C1) — I3C1 error interrupt
92 FMAC — FMAC global interrupt
93 CORDIC — CORDIC interrupt
94 ADC3 — ADC3 global interrupt
95 TIM20_BRK_TERR_IERR (TIM20) — TIM20 Break interrupt/TIM20 Transition error/TIM20 Index error
96 TIM20_UPD (TIM20) — TIM20 Update interrupt
97 TIM20_TRGI_COM_DIR_IDX (TIM20) — TIM20 trigger and commutation interrupt/TIM20 Direction Change interrupt/TIM8 Index
98 TIM20_CC (TIM20) — TIM20 capture compare interrupt
99 TIM10 — TIM10 global interrupt
100 TIM11 — TIM11 global interrupt
101 I3C1_WKUP (I3C1) — I3C wakeup Interrupt through EXTI line
105 XSPI1 (XSPI) — XSPI1 global interrupt
106 HSP1 (HSP) — HSP global interrupt
107 FMC — FMC global interrupt
108 SDMMC1 (SDMMC) — SDMMC1 global interrupt
109 HSP1_ERR (HSP) — HSP error interrupt
110 HSP1_EVT (HSP) — HSP event interrupt
111 HSP1_FWEVT (HSP) — HSP firmware event interrupt
112 OTG_FS — USB OTG FS global/wakeup/vbus interrupt
113 TIM12 — TIM12 global interrupt
114 TIM13 — TIM13 global interrupt
115 TIM14 — TIM14 global interrupt
119 LPTIM1 — LPTIM1 global interrupt
120 LPTIM2 — LPTIM2 global interrupt
121 LPTIM3 — LPTIM3 global interrupt
122 LPTIM4 — LPTIM4 global interrupt
123 LPTIM5 — LPTIM5 global interrupt
124 UART9 — UART9 global interrupt
125 USART10 — USART10 global interrupt
126 ADF1_FLT0 (ADF1) — ADF1 filter 0 global interrupt
127 CRS — CRS global interrupt
128 UCPD1 (UCPD) — UCPD global interrupt
130 USART6 — USART6 global interrupt
131 LPUART1 — LPUART1 global interrupt
{n+125} GPDMA1_CH{n} (GPDMA1) (n=8..15) — GPDMA1 channel {n} interrupt
{n+133} HPDMA1_CH{n} (HPDMA1) (n=8..15) — HPDMA1 channel {n} interrupt
150 FDCAN3_IT0 (FDCAN3) — FDCAN3 interrupt 0
151 FDCAN3_IT1 (FDCAN3) — FDCAN3 interrupt 1
152 FDCAN1_IT0 (FDCAN1) — FDCAN1 interrupt 0
153 FDCAN1_IT1 (FDCAN1) — FDCAN1 interrupt 1
154 FDCAN2_IT0 (FDCAN2) — FDCAN2 interrupt 0
155 FDCAN2_IT1 (FDCAN2) — FDCAN2 interrupt 1
156 DAC12 (DAC) — DAC1/2 underrun interrupt
157 DAC34 — DAC3/4 underrun interrupt
158 DAC56 — DAC5/6 underrun interrupt
159 DAC78 — DAC7/8 underrun interrupt
160 COMP1_OUT (COMP) — COMP1 interrupt through EXTI line
161 COMP2_OUT (COMP) — COMP2 interrupt through EXTI line
162 COMP3_OUT (COMP34) — COMP3 interrupt through EXTI line
163 COMP4_OUT (COMP34) — COMP4 interrupt through EXTI line
164 HRTIM1_M (HRTIM1) — HRtimer1 master interrupt
165 HRTIM1_TIMA (HRTIM1) — HRtimer1 slave1 interrupt
166 HRTIM1_TIMB (HRTIM1) — HRtimer1 slave2 interrupt
167 HRTIM1_TIMC (HRTIM1) — HRtimer1 slave3 interrupt
168 HRTIM1_TIMD (HRTIM1) — HRtimer1 slave4 interrupt
169 HRTIM1_TIME (HRTIM1) — HRtimer1 slave5 interrupt
170 HRTIM1_TIMF (HRTIM1) — HRtimer1 slave6 interrupt
171 HRTIM1_FLT (HRTIM1) — HRtimer1 error interrupt
172 HRTIM2_M (HRTIM1) — HRtimer1 master interrupt
173 HRTIM2_TIMA (HRTIM1) — HRtimer1 slave1 interrupt
174 HRTIM2_TIMB (HRTIM1) — HRtimer1 slave2 interrupt
175 HRTIM2_TIMC (HRTIM1) — HRtimer1 slave3 interrupt
176 HRTIM2_TIMD (HRTIM1) — HRtimer1 slave4 interrupt
177 HRTIM2_TIME (HRTIM1) — HRtimer1 slave5 interrupt
178 HRTIM2_TIMF (HRTIM1) — HRtimer1 slave6 interrupt
179 HRTIM2_FLT (HRTIM1) — HRtimer1 error interrupt
180 COMP5_OUT (COMP56) — COMP5 interrupt through EXTI line
181 COMP6_OUT (COMP56) — COMP6 interrupt through EXTI line
182 COMP7_OUT (COMP78) — COMP7 interrupt through EXTI line
183 COMP8_OUT (COMP78) — COMP8 interrupt through EXTI line
